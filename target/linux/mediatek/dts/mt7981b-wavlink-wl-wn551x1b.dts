// SPDX-License-Identifier: GPL-2.0-only OR MIT

/dts-v1/;

#include "mt7981b-wavlink-wl-wn551x1b.dtsi"

/ {
	mmodel = "WAVLINK WL-WN551X1 Rev B";
	compatible = "wavlink,wl-wn551x1b", "mediatek,mt7981b";
};

&spi_nand {
	mediatek,nmbm;
	mediatek,bmt-max-ratio = <1>;
	mediatek,bmt-max-reserved-blocks = <64>;
};

&ubi {
	reg = <0x580000 0x4000000>;
};
